/**
 * @cliArgs --device "F2837xS" --package "F2837xS_176PTP" --part "F2837xS_176PTP" --product "CLB Configuration Tool@4.1.1"
 * @versions {"tool":"1.12.0+2406"}
 */

/**
 * Import the modules used in this configuration.
 */
const TILE                             = scripting.addModule("/utilities/clb_tool/clb_syscfg/source/TILE");
const TILE1                            = TILE.addInstance();
const TILE2                            = TILE.addInstance();
const clb_run_dynamic_template_clb_c   = scripting.addModule("/utilities/clb_tool/clb_syscfg/source/clb_run_dynamic_template_clb_c.js");
const clb_run_dynamic_template_clb_dot = scripting.addModule("/utilities/clb_tool/clb_syscfg/source/clb_run_dynamic_template_clb_dot.js");
const clb_run_dynamic_template_clb_h   = scripting.addModule("/utilities/clb_tool/clb_syscfg/source/clb_run_dynamic_template_clb_h.js");
const clb_run_dynamic_template_clb_sim = scripting.addModule("/utilities/clb_tool/clb_syscfg/source/clb_run_dynamic_template_clb_sim.js");

/**
 * Write custom configuration values to the imported modules.
 */
TILE1.$name                = "TILE1";
TILE1.BOUNDARY.$name       = "BOUNDARY0";
TILE1.BOUNDARY.in0         = "squareWave";
TILE1.BOUNDARY.in1         = "squareWave";
TILE1.BOUNDARY.in2         = "squareWave";
TILE1.LUT_0.$name          = "LUT_0";
TILE1.LUT_0.eqn            = "~i0";
TILE1.LUT_0.i0             = "BOUNDARY.in0";
TILE1.LUT_1.$name          = "LUT_1";
TILE1.LUT_1.eqn            = "~i0";
TILE1.LUT_1.i0             = "BOUNDARY.in1";
TILE1.LUT_2.$name          = "LUT_2";
TILE1.FSM_0.$name          = "FSM_0";
TILE1.FSM_0.eqn_s0         = "(~s0 & e1) | (s0 & (~e0))";
TILE1.FSM_0.e0             = "COUNTER_0.count_match1";
TILE1.FSM_0.e1             = "COUNTER_1.count_match1";
TILE1.FSM_1.$name          = "FSM_1";
TILE1.FSM_1.e0             = "FSM_0.S0";
TILE1.FSM_1.e1             = "LUT_0.OUT";
TILE1.FSM_1.eqn_s0         = "(!s0&e0)|(s0&e1)";
TILE1.FSM_2.$name          = "FSM_2";
TILE1.FSM_2.e0             = "FSM_1.S0";
TILE1.FSM_2.e1             = "BOUNDARY.in2";
TILE1.FSM_2.eqn_s0         = "(!e0&!s0&s1)|(!e1&s0&!s1)";
TILE1.FSM_2.eqn_s1         = "e0&!s0";
TILE1.FSM_2.eqn_out        = "!s0&s1";
TILE1.COUNTER_0.$name      = "COUNTER_0";
TILE1.COUNTER_0.mode0      = "BOUNDARY.in1";
TILE1.COUNTER_0.mode1      = "1";
TILE1.COUNTER_0.reset      = "LUT_1.OUT";
TILE1.COUNTER_0.match1_val = "8";
TILE1.COUNTER_1.$name      = "COUNTER_1";
TILE1.COUNTER_1.reset      = "BOUNDARY.in1";
TILE1.COUNTER_1.mode1      = "1";
TILE1.COUNTER_1.mode0      = "LUT_1.OUT";
TILE1.COUNTER_1.match1_val = "8";
TILE1.COUNTER_2.$name      = "COUNTER_2";
TILE1.OUTLUT_0.$name       = "OUTLUT_0";
TILE1.OUTLUT_0.eqn         = "0";
TILE1.OUTLUT_1.$name       = "OUTLUT_1";
TILE1.OUTLUT_2.$name       = "OUTLUT_2";
TILE1.OUTLUT_3.$name       = "OUTLUT_3";
TILE1.OUTLUT_4.$name       = "OUTLUT_4";
TILE1.OUTLUT_4.i0          = "FSM_2.OUT";
TILE1.OUTLUT_4.eqn         = "i0";
TILE1.OUTLUT_5.$name       = "OUTLUT_5";
TILE1.OUTLUT_6.$name       = "OUTLUT_6";
TILE1.OUTLUT_7.$name       = "OUTLUT_7";
TILE1.HLC.$name            = "HLC_0";
TILE1.HLC.program0.$name   = "HLCP_0";
TILE1.HLC.program1.$name   = "HLCP_1";
TILE1.HLC.program2.$name   = "HLCP_2";
TILE1.HLC.program3.$name   = "HLCP_3";

TILE2.$name                = "TILE0";
TILE2.BOUNDARY.$name       = "BOUNDARY1";
TILE2.BOUNDARY.in0         = "squareWave";
TILE2.BOUNDARY.in1         = "squareWave";
TILE2.BOUNDARY.in2         = "squareWave";
TILE2.LUT_0.$name          = "LUT_3";
TILE2.LUT_0.i0             = "BOUNDARY.in0";
TILE2.LUT_0.eqn            = "~i0";
TILE2.LUT_1.$name          = "LUT_4";
TILE2.LUT_2.$name          = "LUT_5";
TILE2.FSM_0.$name          = "FSM_3";
TILE2.FSM_0.eqn_s0         = "(~s0 & e1) | (s0 & (~e0))";
TILE2.FSM_0.e0             = "COUNTER_0.count_match1";
TILE2.FSM_0.e1             = "COUNTER_1.count_match1";
TILE2.FSM_1.$name          = "FSM_4";
TILE2.FSM_1.e0             = "FSM_0.S0";
TILE2.FSM_1.e1             = "BOUNDARY.in1";
TILE2.FSM_1.eqn_s0         = "(!s0&e0)|(s0&e1)";
TILE2.FSM_2.$name          = "FSM_5";
TILE2.FSM_2.eqn_out        = "!s0&s1";
TILE2.FSM_2.eqn_s1         = "e0&!s0";
TILE2.FSM_2.e0             = "FSM_1.S0";
TILE2.FSM_2.e1             = "BOUNDARY.in2";
TILE2.FSM_2.eqn_s0         = "(!e0&!s0&s1)|(!e1&s0&!s1)";
TILE2.COUNTER_0.$name      = "COUNTER_3";
TILE2.COUNTER_0.reset      = "BOUNDARY.in0";
TILE2.COUNTER_0.mode0      = "LUT_0.OUT";
TILE2.COUNTER_0.mode1      = "1";
TILE2.COUNTER_0.match1_val = "8";
TILE2.COUNTER_1.$name      = "COUNTER_4";
TILE2.COUNTER_1.reset      = "LUT_0.OUT";
TILE2.COUNTER_1.mode0      = "BOUNDARY.in0";
TILE2.COUNTER_1.mode1      = "1";
TILE2.COUNTER_1.match1_val = "8";
TILE2.COUNTER_2.$name      = "COUNTER_5";
TILE2.OUTLUT_0.$name       = "OUTLUT_8";
TILE2.OUTLUT_0.eqn         = "0";
TILE2.OUTLUT_1.$name       = "OUTLUT_9";
TILE2.OUTLUT_2.$name       = "OUTLUT_10";
TILE2.OUTLUT_3.$name       = "OUTLUT_11";
TILE2.OUTLUT_4.$name       = "OUTLUT_12";
TILE2.OUTLUT_4.eqn         = "i0";
TILE2.OUTLUT_4.i0          = "FSM_2.OUT";
TILE2.OUTLUT_5.$name       = "OUTLUT_13";
TILE2.OUTLUT_6.$name       = "OUTLUT_14";
TILE2.OUTLUT_7.$name       = "OUTLUT_15";
TILE2.HLC.$name            = "HLC_1";
TILE2.HLC.program0.$name   = "HLCP_4";
TILE2.HLC.program1.$name   = "HLCP_5";
TILE2.HLC.program2.$name   = "HLCP_6";
TILE2.HLC.program3.$name   = "HLCP_7";
